## components/led_strip/Kconfig.projbuild
```kconfig
menu "RMT_LED_STRIP Configuration"
    config RMT_TX_GPIO
        int "RMT TX GPIO"
        default 48
        help
            Set the GPIO number used for transmitting the RMT signal.

    config STRIP_RESOLUTION_HZ
        int "STRIP_RESOLUTION_HZ"
        default 10000000
        help
            Set the strip resolution for the RMT signal. 10MHz resolution, 1 tick = 0.1us (led strip needs a high resolution)
endmenu
```

## components/lvgl_hw/Kconfig
```kconfig
menu "LVGL_Hardware Configuration"
    
    choice  LCD_HOST
        prompt  "spihost number to use"
        default SPI2_HOST
        help
            Set the spihost number to use.
        
        config SPI1_HOST
            bool "SPI1_HOST"

        config SPI2_HOST
            bool "SPI2_HOST" 
            
        config SPI3_HOST
            bool "SPI3_HOST"
    endchoice   
    config LCD_HOST
        int
        default 0 if SPI1_HOST
        default 1 if SPI2_HOST
        default 2 if SPI3_HOST



    config LCD_PIXEL_CLOCK_HZ
        int "clock for the spibus LCD"
        default 40000000
        help
            Set the clock for the spibus LCD.

    config LCD_BK_LIGHT_ON_LEVEL
        int "backlight on level"
        range 0 1
        default 1
        help
            Set the backlight on level.

    config PIN_NUM_DATA0
        int "data pin for spibus"
        range 1 48
        default 16
        help
            Set the data pin for spibus.   
        
    config PIN_NUM_PCLK
        int "clock pin for spibus"
        range 1 48
        default 15
        help
            Set the clock pin for spibus.
        
    config PIN_NUM_CS
        int "choose pin for spibus"
        range 1 48
        default 8
        help
            Set the choose pin for spibus.     
        
    config PIN_NUM_DC
        int "dc pin for spibus"
        range 1 48
        default 18
        help
            Set the dc pin for spibus.       
        
    config PIN_NUM_RST
        int "reset pin for spibus"
        range 1  48
        default 17
        help
            Set the reset pin for spibus.    
                
    config PIN_NUM_BK_LIGHT
        int "backlight pin for spibus"
        range 1 48
        default 19
        help
            Set the backlight pin for spibus.        
        
        
        
    config LCD_H_RES
        int "LCD horizontal resolution."
        default 240
        help
            Set the LCD horizontal resolution.       
                
    config LCD_V_RES
        int "LCD vertical resolution"
        default 240
        help
            Set the LCD vertical resolution.
                     
            


    config DISP_BUF_SIZE
        int "display buffer size"
        default 10240
        help
            Set the display buffer size.   
            
    
    config LVGL_TICK_PERIOD_MS
        int "lvgl ticks_ms"
        default 1
        help
            Set the lvgl ticks_ms.         
        
        
        
        
        
        
        
        
        
        
        
        
        
        
        
        
        
        
        
        
        
        
        endmenu
```

## components/typec_pd/Kconfig
```kconfig
menu "Type-C/PD Options"

    config CONFIG_FSC_DEBUG
        bool "include fsc debug"
        default n
    config FSC_HAVE_DRP
        bool "include fsc have drp"
        default n
    config FSC_HAVE_SRC
        bool "include fsc have src"
        default n
    config FSC_HAVE_SNK
        bool "include fsc have snk"
        default n
    config FSC_HAVE_VDM
        bool "include fsc have vdm"
        default n
    config FSC_HAVE_EXT_MSG
        bool "include fsc have ext_msg"
        default n
    config FSC_HAVE_DP
        bool "include fsc have dp"
        default n
         
endmenu
```
